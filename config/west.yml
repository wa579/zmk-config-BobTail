## config/west.yml
```yaml
manifest:
  remotes:
    - name: zmkfirmware
      url-base: https://github.com/zmkfirmware
    - name: cormoran
      url-base: https://github.com/cormoran
    - name: wa579
      url-base: https://github.com/wa579

  projects:
    - name: zmk
      remote: cormoran
      revision: main+custom-studio-protocol
      import:
        file: app/west.yml

    - name: zmk-pmw3610-driver
      remote: wa579
      revision: bobtail-cormoran-compat

  self:
    path: config
```
